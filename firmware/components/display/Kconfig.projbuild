## firmware/components/display/Kconfig.projbuild
```kconfig
menu "Display (OLED)"

choice DISPLAY_CONTROLLER
    prompt "Controlador OLED"
    default DISPLAY_CONTROLLER_SH1106

    config DISPLAY_CONTROLLER_SH1106
        bool "SH1106 (panel 1.3\")"

    config DISPLAY_CONTROLLER_SSD1306
        bool "SSD1306 (panel 0.96\")"
endchoice

config DISPLAY_COL_OFFSET
    int "Offset de columnas del panel"
    default 2 if DISPLAY_CONTROLLER_SH1106
    default 0 if DISPLAY_CONTROLLER_SSD1306
    help
        Desplazamiento horizontal del framebuffer respecto al panel.
        SH1106 (1.3\"): 2. SSD1306 (0.96\"): 0.

endmenu
```

## firmware/sdkconfig.defaults
```kconfig
CONFIG_IDF_TARGET="esp32s3"
CONFIG_ESPTOOLPY_FLASHSIZE_16MB=y

CONFIG_PARTITION_TABLE_CUSTOM=y
CONFIG_PARTITION_TABLE_CUSTOM_FILENAME="partitions.csv"

CONFIG_BT_ENABLED=y
CONFIG_BLUEDROID_ENABLED=y
CONFIG_BT_BLE_ENABLED=y
CONFIG_BLE_SMP_ENABLE=y
CONFIG_BT_BLE_42_FEATURES_SUPPORTED=y
CONFIG_BT_BLE_50_FEATURES_SUPPORTED=n

CONFIG_TINYUSB_ENABLED=y
CONFIG_TINYUSB_HID_COUNT=1

CONFIG_PM_ENABLE=y

CONFIG_MAIN_TASK_STACK_SIZE=4096
```
